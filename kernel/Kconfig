## kernel/Kconfig
```kconfig
menu "KernelSU"

config KSU
	tristate "KernelSU function support"
	depends on EXT4_FS
	default y
	help
	  Enable kernel-level root privileges on Android System.
	  Requires CONFIG_EXT4_FS for `ext4_unregister_sysfs`.
	  Use KSU_KPROBES_HOOK on GKI kernels with kprobe support, or
	  KSU_MANUAL_HOOK for legacy/non-GKI integrations.
	  To compile as a module, choose M here: the
	  module will be called kernelsu.

config KSU_DEBUG
	bool "KernelSU debug mode"
	depends on KSU
	default n
	help
	  Enable KernelSU debug mode.

config KSU_DISABLE_MANAGER
	bool "Disable KernelSU manager integration"
	depends on KSU
	default n
	help
	  Disable manager APK detection and manager-specific handling.
	  Root will be used in place of manager-only functionality.

config KSU_DISABLE_POLICY
	bool "Disable KernelSU policy profiles"
	depends on KSU
	default n
	help
	  Disable per-app root/non-root profile customization.
	  Escalation will always use the default full root profile, and
	  non-root handling will follow the global umount policy only.

# For easier extern ifdef handling
config KSU_MANUAL_HOOK
	bool "KernelSU manual hook mode."
	depends on KSU && KSU != m
	default y if !KPROBES
	default n
	help
	  Enable manual hook support.

config KSU_KPROBES_HOOK
	bool "KernelSU tracepoint+kretprobe hook"
	depends on KSU && !KSU_MANUAL_HOOK
	depends on KRETPROBES && KPROBES && HAVE_SYSCALL_TRACEPOINTS
	default y if KPROBES && KRETPROBES && HAVE_SYSCALL_TRACEPOINTS
	default y if !KSU_MANUAL_HOOK
	help
	  Enable KPROBES, KRETPROBES and TRACEPOINT hook for KernelSU core.
	  ARM64 syscall and LSM layouts are selected from the target headers.
	  Kernels below 5.10 still require the dependencies above and should be
	  validated on the target device.

config KSU_TAMPER_SYSCALL_TABLE
	bool "KernelSU syscall-table tamper hook"
	depends on KSU_KPROBES_HOOK
	depends on ARM64 || X86_64
	default n
	help
	  Replace hooked syscall table entries directly instead of routing
	  them through the sys_enter tracepoint dispatcher. This mirrors the
	  downstream KernelSU syscall-table tamper mode while reusing
	  KernelSU-Next's central syscall handlers.

config KSU_HACK_ARM64_BRANCH_LINK
	bool "Experimental KernelSU ARM64 branch-link hook"
	depends on KSU_KPROBES_HOOK && ARM64 && KALLSYMS
	depends on !KSU_TAMPER_SYSCALL_TABLE
	default n
	help
	  EXPERIMENTAL: patch selected ARM64 syscall callsites by rewriting
	  branch-with-link instructions so sucompat/exec path handling can run
	  without redirecting those syscalls through the tracepoint dispatcher.
	  This is intended for Android ARM64 kernels with the standard syscall
	  wrapper layout and should be validated on the target device. Module
	  builds still require the hook text to land within the ARM64 BL
	  +/-128 MiB range, otherwise patching will be refused at runtime.

config KSU_KPROBES_SUSFS
	bool "KernelSU hookless SUSFS"
	depends on KSU && KSU != m && KSU_KPROBES_HOOK
	default n
	help
	  Enable the hookless SUSFS runtime hosted entirely inside
	  KernelSU-Next. This keeps SUSFS out of the main kernel tree and
	  relies on KSU-owned VFS/procfs/syscall runtime hooks instead of
	  per-version source patching.
	  MM and VFS compatibility is selected from the APIs present in the
	  source tree. Stock-style 4.19 and 5.4 ARM64 kernels are the primary
	  legacy targets; 4.9 is best-effort when all Kprobes, syscall
	  tracepoint, procfs, and Android vendor dependencies are present.
	  Supported on this branch:
	  - sus_path / add_sus_path
	  - sus_path_loop / add_sus_path_loop
	  - open_redirect / add_open_redirect
	  - sus_mount / hide_sus_mnts_for_non_su_procs
	  - sus_kstat / add_sus_kstat / update_sus_kstat
	  - sus_map / add_sus_map
	  - spoof_cmdline_or_bootconfig
	    (cmdline only on kernels without proc bootconfig)
	  - spoof_uname
	  - avc_log_spoofing
	  When KSU_HACK_ARM64_BRANCH_LINK is enabled on ARM64, SUSFS uses
	  direct branch-link/function-pointer hooks for kstat and mount
	  tracking instead of installing its kprobe/kretprobe runtime hooks.

config KSU_KPROBES_NOMOUNT
	bool "KernelSU hookless NoMount"
	depends on KSU_KPROBES_SUSFS
	depends on NET
	depends on ARM64
	depends on KALLSYMS
	default y
	help
	  Enable a KernelSU-hosted NoMount-compatible VFS redirection
	  runtime. This keeps NoMount out of fs/ and redirects pathnames at
	  the native filename constructors, while preserving the Generic
	  Netlink family and command ABI used by the existing nm userspace
	  tool.

	  This implementation supports exact child injection, replacement,
	  whiteout, synthetic intermediate virtual directories, UID
	  blocking, rule listing, and clear commands. It intentionally
	  avoids fabricated inodes and superblock/VFS-operation wrappers.
	  It requires ARM64 kprobe entry redirection and kretprobes on the
	  target kernel; Android ARM64 4.19 and 5.4 configurations with those
	  facilities are the supported targets.

endmenu
```
